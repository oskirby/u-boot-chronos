## board/ti/chronos14/Kconfig
```kconfig
if TARGET_CHRONOS14

config SYS_BOARD
	default "chronos14"

config SYS_VENDOR
	default "ti"

config SYS_SOC
	default "am33xx"

config SYS_CONFIG_NAME
	default "chronos14"

endif
```
